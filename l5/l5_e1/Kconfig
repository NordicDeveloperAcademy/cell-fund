## l5/l5_e1/Kconfig
```kconfig
#
# Copyright (c) 2019 Nordic Semiconductor ASA
#
# SPDX-License-Identifier: LicenseRef-Nordic-5-Clause
#

menu "Cellfund Lesson 5 Exercise"

config COAP_SERVER_HOSTNAME
	string "CoAP server hostname"

config COAP_SERVER_PORT
	int "CoAP server port"
	default 5683

config COAP_TX_RESOURCE
	string "CoAP resource - this is the TX channel of the board"
	default "large-update"

config COAP_RX_RESOURCE
	string "CoAP resource - this is the RX channel of the board"
	default "validate"

config DK
	bool "nRF9151 DK, nRF9161 DK or nRF9160 DK"
	default y if (BOARD_NRF9160DK_NRF9160_NS) || (BOARD_NRF9161DK_NRF9161_NS) || (BOARD_NRF9151DK_NRF9151_NS)

config THINGY
	bool "Thingy:91 X or Thingy:91"
	default y if (BOARD_THINGY91_NRF9160_NS) || (BOARD_THINGY91X_NRF9151_NS)
	
endmenu

menu "Zephyr Kernel"
source "Kconfig.zephyr"
endmenu
```

## l8/l8_sol/sample.yaml
```yaml
sample:
  description: Cellular IoT Fundamentals Course by Nordic Developer Academy (https://academy.nordicsemi.com/)
  name: Cellular IoT Fundamentals Course - Lesson 8 Exercise 1 Solution
  
common: 
    sysbuild: true
    build_only: true
    integration_platforms: 
      - nrf9151dk/nrf9151/ns
      - nrf9161dk/nrf9161/ns
      - nrf9160dk/nrf9160/ns
      - thingy91x/nrf9151/ns
      - thingy91/nrf9160/ns
    platform_exclude:
      - native_sim
    
tests:
  cell_fund.l8.e1_sol: {}
```

## v2.4.0/lesson6/cellfund_less6_exer2_solution/sample.yaml
```yaml
sample:
  name: Cellular Fundamentals Course
tests:
  samples.cellular.fundamentals_course:
    build_only: true
    platform_allow: nrf9160dk_nrf9160_ns thingy91_nrf9160_ns
    integration_platforms:
      - nrf9160dk_nrf9160_ns
      - thingy91_nrf9160_ns
    tags: ci_build
```

## v2.9.0-v2.7.0/l7/l7_e1_sol/Kconfig
```kconfig
#
# Copyright (c) 2019 Nordic Semiconductor ASA
#
# SPDX-License-Identifier: LicenseRef-Nordic-5-Clause
#

menu "Cellfund Lesson 5 Exercise"

config COAP_SERVER_HOSTNAME
	string "CoAP server hostname"

config COAP_SERVER_PORT
	int "CoAP server port"
	default 5683

config COAP_TX_RESOURCE
	string "CoAP resource - this is the TX channel of the board"
	default "large-update"

config COAP_RX_RESOURCE
	string "CoAP resource - this is the RX channel of the board"
	default "validate"

# STEP 2.1 - Define the PSK Identity configuration
config COAP_DEVICE_NAME
	string "Device resource name - this will be the device name on the CoAP server"
	default "cali.test.nrf91"

# STEP 2.2 - Define the PSK Secret configuration	
config COAP_SERVER_PSK
	string "Server PSK"
	default "2e666f726e69756d"

config DK
	bool "nRF9151 DK, nRF9161 DK or nRF9160 DK"
	default y if (BOARD_NRF9160DK_NRF9160_NS) || (BOARD_NRF9161DK_NRF9161_NS) || (BOARD_NRF9151DK_NRF9151_NS)

config THINGY
	bool "Thingy:91 X or Thingy:91"
	default y if (BOARD_THINGY91_NRF9160_NS) || (BOARD_THINGY91X_NRF9151_NS)
	
endmenu

menu "Zephyr Kernel"
source "Kconfig.zephyr"
endmenu
```
